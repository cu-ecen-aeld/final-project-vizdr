## meta-can-visualizer/conf/layer.conf
```bitbake
# Layer configuration for meta-can-visualizer
# Qt6 QML CAN Data Visualization Application

BBPATH .= ":${LAYERDIR}"

BBFILES += "${LAYERDIR}/recipes-*/*/*.bb \
            ${LAYERDIR}/recipes-*/*/*.bbappend"

BBFILE_COLLECTIONS += "can-visualizer"
BBFILE_PATTERN_can-visualizer := "^${LAYERDIR}/"
BBFILE_PRIORITY_can-visualizer = "8"

LAYERSERIES_COMPAT_can-visualizer = "kirkstone"
LAYERDEPENDS_can-visualizer = "core qt6-layer"
```
