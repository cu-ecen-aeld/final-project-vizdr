## meta-ledhat/conf/layer.conf
```bitbake
# Minimal layer.conf for meta-ledhat
BBPATH .= ":${LAYERDIR}"

BBFILES += "${LAYERDIR}/recipes-*/*/*.bb \
            ${LAYERDIR}/recipes-*/*/*.bbappend"

BBFILE_COLLECTIONS += "ledhat"
BBFILE_PATTERN_ledhat = "^${LAYERDIR}/"
BBFILE_PRIORITY_ledhat = "7"

LAYERSERIES_COMPAT_ledhat = "kirkstone"
LAYERDEPENDS_ledhat = "core raspberrypi"

RPI_EXTRA_CONFIG += "dtparam=audio=off"
RPI_EXTRA_CONFIG += "dtoverlay=pwm,pin=18,func=2"

DESCRIPTION = "ledhat: WS2812B LED HAT demo for Raspberry Pi"
```
